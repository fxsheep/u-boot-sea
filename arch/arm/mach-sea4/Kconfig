## arch/arm/mach-sea4/Kconfig
```kconfig
# SPDX-License-Identifier: GPL-2.0

if ARCH_SEA4

config SEA4
	bool
	select DM_SERIAL
	select SYS_NS16550

config SYS_BOARD
	string "Board name"
	default "sea4"

config SYS_VENDOR
	string "Vendor name"
	default "Seagate"

config SYS_SOC
	default "sea4"

config CPU_FREQ_HZ
	int "CPU frequency"
	default 800000000
	help
	  The value, in Hz, that the CPU clock is running at.

config TARGET_SEA4
	bool "Support Seagate SEA4 HDD controller"
	select SEA4

source "board/Seagate/sea4/Kconfig"

endif
```

## board/Seagate/sea4/Kconfig
```kconfig
if TARGET_SEA4

config SYS_BOARD
	default "sea4"

config SYS_VENDOR
	default "Seagate"

config SYS_CONFIG_NAME
	default "sea4"

endif
```

## configs/sea4_defconfig
```kconfig
CONFIG_ARM=y
CONFIG_SKIP_LOWLEVEL_INIT=y
CONFIG_ARCH_CPU_INIT=y
CONFIG_ARCH_SEA4=y
CONFIG_TEXT_BASE=0x40000000
CONFIG_TARGET_SEA4=y
CONFIG_SYS_LOAD_ADDR=0x41000000
CONFIG_IDENT_STRING="\nSeagate SEA4 HDD controller"
CONFIG_USE_PREBOOT=y
CONFIG_SYS_PBSIZE=1053
CONFIG_SYS_PROMPT="SEA4> "
CONFIG_SYS_MAXARGS=32
CONFIG_OF_CONTROL=y
CONFIG_TIMER=y
CONFIG_DESIGNWARE_APB_TIMER=y
CONFIG_DEFAULT_DEVICE_TREE="sea4"
```
